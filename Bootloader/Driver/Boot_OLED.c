#include "Boot_OLED.h"
#include "Boot_Timer.h"

#define OLED_ADDR 0x78U

static uint8_t oled_gram[128][4];

static const uint8_t boot_font_1608[][16] = {
    {0x00U,0x00U,0x00U,0x00U,0x00U,0x00U,0x00U,0x00U,0x00U,0x00U,0x00U,0x00U,0x00U,0x00U,0x00U,0x00U},
    {0x00U,0x00U,0x07U,0xF0U,0x08U,0x08U,0x10U,0x04U,0x10U,0x04U,0x08U,0x08U,0x07U,0xF0U,0x00U,0x00U},
    {0x00U,0x00U,0x08U,0x04U,0x08U,0x04U,0x1FU,0xFCU,0x00U,0x04U,0x00U,0x04U,0x00U,0x00U,0x00U,0x00U},
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    {0x01U,0x04U,0x01U,0x04U,0x01U,0xFCU,0x00U,0x84U,0x01U,0x04U,0x01U,0x00U,0x01U,0x80U,0x00U,0x00U}
};

static void iic_delay(void)
{
    uint16_t t = 120U;
    while(t--) {
    }
}

static void iic_scl(uint8_t v)
{
    gpio_bit_write(GPIOB, GPIO_PIN_4, v ? SET : RESET);
}

static void iic_sda(uint8_t v)
{
    gpio_bit_write(GPIOB, GPIO_PIN_5, v ? SET : RESET);
}

static void iic_start(void)
{
    iic_sda(1U); iic_scl(1U); iic_delay(); iic_sda(0U); iic_delay(); iic_scl(0U); iic_delay();
}

static void iic_stop(void)
{
    iic_sda(0U); iic_delay(); iic_scl(1U); iic_delay(); iic_sda(1U); iic_delay();
}

static void iic_send(uint8_t data)
{
    uint8_t i;
    for(i = 0U; i < 8U; i++) {
        iic_sda((data & 0x80U) != 0U);
        iic_delay(); iic_scl(1U); iic_delay(); iic_scl(0U); data <<= 1;
    }
    iic_sda(1U); iic_delay(); iic_scl(1U); iic_delay(); iic_scl(0U); iic_delay();
}

static void oled_write(uint8_t data, uint8_t cmd)
{
    iic_start(); iic_send(OLED_ADDR); iic_send(cmd == 0U ? 0x00U : 0x40U); iic_send(data); iic_stop();
}

static void oled_clear(void)
{
    uint8_t p, x;
    memset(oled_gram, 0, sizeof(oled_gram));
    for(p = 0U; p < 4U; p++) {
        oled_write(0xB0U + p, 0U); oled_write(0x00U, 0U); oled_write(0x10U, 0U);
        iic_start(); iic_send(OLED_ADDR); iic_send(0x40U);
        for(x = 0U; x < 128U; x++) iic_send(0x00U);
        iic_stop();
    }
}

static void oled_refresh(void)
{
    uint8_t p, x;
    for(p = 0U; p < 4U; p++) {
        oled_write(0xB0U + p, 0U); oled_write(0x00U, 0U); oled_write(0x10U, 0U);
        iic_start(); iic_send(OLED_ADDR); iic_send(0x40U);
        for(x = 0U; x < 128U; x++) iic_send(oled_gram[x][p]);
        iic_stop();
    }
}

static void oled_draw_point(uint8_t x, uint8_t y, uint8_t on)
{
    if((x >= 128U) || (y >= 32U)) return;
    if(on != 0U) oled_gram[x][y >> 3U] |= (uint8_t)(1U << (y & 7U));
    else oled_gram[x][y >> 3U] &= (uint8_t)~(1U << (y & 7U));
}

static uint8_t boot_font_index(char ch)
{
    if((ch >= '0') && (ch <= '9')) return (uint8_t)(ch - '0' + 1);
    if(ch == 'B') return 11U;
    if(ch == 'o') return 12U;
    if(ch == 't') return 13U;
    if(ch == 'l') return 14U;
    if(ch == 'a') return 15U;
    if(ch == 'd') return 16U;
    if(ch == 'e') return 17U;
    if(ch == 'r') return 18U;
    return 0U;
}

static void oled_show_char_1608(uint8_t x, uint8_t y, char ch)
{
    uint8_t temp, t, t1;
    uint8_t y0 = y;
    const uint8_t *pfont = boot_font_1608[boot_font_index(ch)];
    if(y + 16U > 32U) return;
    for(t = 0U; t < 16U; t++) {
        temp = pfont[t];
        for(t1 = 0U; t1 < 8U; t1++) {
            oled_draw_point(x, y, (temp & 0x80U) != 0U);
            temp <<= 1U;
            y++;
            if((y - y0) == 16U) {
                y = y0;
                x++;
                break;
            }
        }
    }
}

static void oled_show_string_1608(uint8_t x, uint8_t y, const char *text)
{
    while((*text != '\0') && (x <= 120U)) {
        oled_show_char_1608(x, y, *text++);
        x = (uint8_t)(x + 8U);
    }
}

void Boot_OLED_Show(void)
{
    oled_clear();
    oled_show_string_1608(0U, 0U, "2026413756");
    oled_show_string_1608(0U, 16U, "Bootloader");
    oled_refresh();
}

void Boot_OLED_Init(void)
{
    rcu_periph_clock_enable(RCU_GPIOB);
    gpio_mode_set(GPIOB, GPIO_MODE_OUTPUT, GPIO_PUPD_PULLUP, GPIO_PIN_4 | GPIO_PIN_5);
    gpio_output_options_set(GPIOB, GPIO_OTYPE_OD, GPIO_OSPEED_50MHZ, GPIO_PIN_4 | GPIO_PIN_5);
    iic_stop();
    Boot_DelayMs(100U);
    oled_write(0xAEU,0U); oled_write(0x00U,0U); oled_write(0x10U,0U); oled_write(0x40U,0U); oled_write(0x81U,0U); oled_write(0xCFU,0U);
    oled_write(0xA1U,0U); oled_write(0xC8U,0U); oled_write(0xA6U,0U); oled_write(0xA8U,0U); oled_write(0x1FU,0U); oled_write(0xD3U,0U);
    oled_write(0x00U,0U); oled_write(0xD5U,0U); oled_write(0x80U,0U); oled_write(0xD9U,0U); oled_write(0xF1U,0U); oled_write(0xDAU,0U);
    oled_write(0x00U,0U); oled_write(0xDBU,0U); oled_write(0x40U,0U); oled_write(0x20U,0U); oled_write(0x02U,0U); oled_write(0x8DU,0U);
    oled_write(0x14U,0U); oled_write(0xA4U,0U); oled_write(0xA6U,0U); oled_write(0xAFU,0U);
    oled_clear();
    Boot_OLED_Show();
}
